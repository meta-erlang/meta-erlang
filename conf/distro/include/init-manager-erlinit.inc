## conf/distro/include/init-manager-erlinit.inc
```bitbake
# enable erlinit for init
DISTRO_FEATURES:append = " erlinit"
DISTRO_FEATURES_BACKFILL_CONSIDERED:append = " systemd sysvinit mdev-busybox"
VIRTUAL-RUNTIME_initscripts = ""
VIRTUAL-RUNTIME_init_manager ?= "erlinit"
VIRTUAL-RUNTIME_login_manager = ""
VIRTUAL-RUNTIME_syslog = ""
VIRTUAL-RUNTIME_dev_manager = ""
VIRTUAL-RUNTIME_keymaps = ""
VIRTUAL-RUNTIME_update-alternatives = ""
```

## conf/layer.conf
```bitbake
# We have a conf and classes directory, append to BBPATH 
BBPATH .= ":${LAYERDIR}"

# We have a recipes directory, add to BBFILES
BBFILES += "${LAYERDIR}/recipes-*/*/*.bb ${LAYERDIR}/recipes-*/*/*.bbappend"

BBFILE_COLLECTIONS += "erlang-layer"
BBFILE_PATTERN_erlang-layer := "^${LAYERDIR}/"
BBFILE_PRIORITY_erlang-layer = "7"
LAYERSERIES_COMPAT_erlang-layer = "scarthgap"

LAYERDEPENDS_erlang-layer = "core"

# meta-oe is needed to build/run erlang with odbc support
LAYERRECOMMENDS_erlang-layer = "meta-oe"

# meta-networking is need to run erlang with lksctp support
LAYERRECOMMENDS_erlang-layer += "meta-networking"

BBFILES_DYNAMIC += "\
    openembedded-layer:${LAYERDIR}/dynamic-layers/meta-oe/recipes-*/*/*.bb \
    openembedded-layer:${LAYERDIR}/dynamic-layers/meta-oe/recipes-*/*/*.bbappend \
    openembedded-layer:${LAYERDIR}/dynamic-layers/meta-networking/recipes-*/*/*.bb \
    openembedded-layer:${LAYERDIR}/dynamic-layers/meta-networking/recipes-*/*/*.bbappend \
    "
```
